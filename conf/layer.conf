## conf/layer.conf
```bitbake
#
# Copyright (C) 2017 Wind River Systems, Inc.
#

BBPATH ?= ""
# We have a conf and classes directory, add to BBPATH
BBPATH := "${LAYERDIR}:${BBPATH}"

# We have a packages directory, add to BBFILES
BBFILES := "${BBFILES} ${LAYERDIR}/recipes-*/*/*.bb \
	${LAYERDIR}/recipes-*/*/*.bbappend \
	${LAYERDIR}/classes/*.bbclass"

BBFILE_COLLECTIONS += "ti-am335x"
BBFILE_PATTERN_ti-am335x = "^${LAYERDIR}/"
BBFILE_PRIORITY_ti-am335x = "7"

PREMIRRORS_append = " \
        git://.*/.* file://${LAYERDIR}/downloads/ \n \
        https://.*/.* file://${LAYERDIR}/downloads/ \n"

# This should only be incremented on significant changes that will
# cause compatibility issues with other layers
LAYERVERSION_ti-am335x = "1"

LAYERDEPENDS_ti-am335x = "core wr-kernel"
```

## conf/machine/omap3.inc
```bitbake
#@TYPE: Machine inc.
#@NAME: ti-omap3 layer

require conf/machine/include/tune-cortexa8.inc

MACHINE_FEATURES += " usbgadget usbhost jffs2 ext2 screen alsa vfat"

KERNEL_IMAGETYPE = "zImage"

SERIAL_CONSOLE = "115200 ttyO0"

IMAGE_FSTYPES ?= "tar.bz2"
```

## conf/machine/ti-am335x.conf
```bitbake
# Copyright (C) 2023 Wind River Systems, Inc.

#@TYPE: Machine
#@NAME: ti-am335x EVM & BBB
#@DESCRIPTION: Machine configuration for TI AM335x SoC

require ti-am335x.inc
```

## conf/machine/ti-am335x.inc
```bitbake
DEFAULTTUNE ?= "cortexa8thf-neon"
require conf/machine/include/arm/armv7a/tune-cortexa8.inc

KERNEL_DTBDEST = "${KERNEL_IMAGEDEST}/dtb"
KERNEL_DTBVENDORED = "1"

MACHINE_FEATURES += "usbhost jffs2 ext2 screen alsa"

DISTRO_FEATURES:append = " vfat wifi bluetooth"

KERNEL_IMAGETYPE = "zImage"
KERNEL_DEVICETREE = "am335x-evm.dtb am335x-boneblack.dtb"

SERIAL_CONSOLE = "115200 ttyS0"

PREFERRED_PROVIDER_virtual/kernel ??= "linux-yocto"

IMAGE_INSTALL:append = " kernel-devicetree kernel-image-zimage"

IMAGE_FSTYPES += "tar.bz2 wic wic.bmap"
WKS_FILE ?= "am335x-sdimage.wks"
do_image_wic[depends] += " mtools-native:do_populate_sysroot dosfstools-native:do_populate_sysroot"
IMAGE_BOOT_FILES ?= " zImage am335x-evm.dtb am335x-boneblack.dtb u-boot.img MLO u-boot-spl.bin"

UBOOT_MACHINE = "am335x_evm_config"
UBOOT_ARCH = "arm"
UBOOT_SUFFIX = "img"
SPL_BINARY = "MLO"

PREFERRED_PROVIDER_virtual/egl = "${@bb.utils.contains("MACHINE_FEATURES", "gpu", "mesa-pvr", "mesa", d)}"
PREFERRED_PROVIDER_virtual/libgles3 = "${@bb.utils.contains("MACHINE_FEATURES", "gpu", "mesa-pvr", "mesa", d)}"
PREFERRED_PROVIDER_virtual/libgles2 = "${@bb.utils.contains("MACHINE_FEATURES", "gpu", "mesa-pvr", "mesa", d)}"
PREFERRED_PROVIDER_virtual/libgles1 = "${@bb.utils.contains("MACHINE_FEATURES", "gpu", "mesa-pvr", "mesa", d)}"
PREFERRED_PROVIDER_virtual/libgbm = "${@bb.utils.contains("MACHINE_FEATURES", "gpu", "mesa-pvr", "mesa", d)}"
PREFERRED_PROVIDER_virtual/libgl = "${@bb.utils.contains("MACHINE_FEATURES", "gpu", "mesa-pvr", "mesa", d)}"
PREFERRED_PROVIDER_virtual/libglx = "${@bb.utils.contains("MACHINE_FEATURES", "gpu", "mesa-pvr", "mesa", d)}"
PREFERRED_PROVIDER_virtual/mesa = "${@bb.utils.contains("MACHINE_FEATURES", "gpu", "mesa-pvr", "mesa", d)}"
PVR_DISPLAY_CONTROLLER_ALIAS ?= "tilcdc"
PREFERRED_PROVIDER_virtual/gpudriver ?= "${@bb.utils.contains("MACHINE_FEATURES", "gpu", "ti-sgx-ddk-km", "", d)}"
```

## wic/am335x-sdimage.wks
```
# short-description: Create SD card image with a boot partition
# long-description: Creates a partitioned SD card image. Boot files
# are located in the first vfat partition.

part /boot --source bootimg-partition --ondisk mmcblk0 --fstype=vfat --label boot --active --align 512 --fixed-size 128 --use-uuid
part / --source rootfs --ondisk mmcblk0 --fstype=ext4 --label root --align 512 --use-uuid
```
